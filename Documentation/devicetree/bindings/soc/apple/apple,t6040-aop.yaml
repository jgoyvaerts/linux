## Documentation/devicetree/bindings/soc/apple/apple,t6040-aop.yaml
```yaml
# SPDX-License-Identifier: (GPL-2.0-only OR BSD-2-Clause)
%YAML 1.2
---
$id: http://devicetree.org/schemas/soc/apple/apple,t6040-aop.yaml#
$schema: http://devicetree.org/meta-schemas/core.yaml#

title: Apple T6040 Always-On Processor

maintainers:
  - Jonathan Goyvaerts <jonathan.goyvaerts@gmail.com>

description:
  The Always-On Processor provides audio and sensor services through firmware
  loaded by the bootloader. The application processor patches the firmware's
  boot arguments in the AOP SRAM, starts it through RTKit over one mailbox and
  reaches its services through the RTKit endpoints. The bootloader reserves
  the firmware's external code and log segments as /reserved-memory nodes
  named aop-etext and aop-oslog; no mapping of them survives the reset of the
  AOP's DART, so the operating system maps them again before the start.

properties:
  compatible:
    const: apple,t6040-aop

  reg:
    items:
      - description: AOP SRAM, holding the boot-argument table
      - description: ASC wrapper and processor control registers

  reg-names:
    items:
      - const: firmware
      - const: asc

  mboxes:
    maxItems: 1

  mbox-names:
    const: mbox

  iommus:
    maxItems: 1

  audio:
    type: object
    description: The audio service.

  als:
    type: object
    description: The ambient light sensor service.
    additionalProperties: false

    properties:
      compatible:
        items:
          - const: apple,t6040-aop-als
          - const: apple,aop-als

    required:
      - compatible

  las:
    type: object
    description: The lid angle sensor service.
    additionalProperties: false

    properties:
      compatible:
        items:
          - const: apple,t6040-aop-las
          - const: apple,aop-las

    required:
      - compatible

required:
  - compatible
  - reg
  - mboxes
  - mbox-names
  - iommus

additionalProperties: false

examples:
  - |
    soc {
        #address-cells = <2>;
        #size-cells = <2>;

        aop@510c10000 {
            compatible = "apple,t6040-aop";
            reg = <0x5 0x10c10000 0x0 0x2e0000>,
                  <0x5 0x10600000 0x0 0x88000>;
            reg-names = "firmware", "asc";
            mboxes = <&aop_mbox>;
            mbox-names = "mbox";
            iommus = <&aop_dart 0>;

            als {
                compatible = "apple,t6040-aop-als", "apple,aop-als";
            };

            las {
                compatible = "apple,t6040-aop-las", "apple,aop-las";
            };
        };
    };
```

## Documentation/devicetree/bindings/soc/apple/apple,t6041-aop.yaml
```yaml
# SPDX-License-Identifier: (GPL-2.0-only OR BSD-2-Clause)
%YAML 1.2
---
$id: http://devicetree.org/schemas/soc/apple/apple,t6041-aop.yaml#
$schema: http://devicetree.org/meta-schemas/core.yaml#

title: Apple T604x Always-On Processor

maintainers:
  - Jonathan Goyvaerts <jonathan.goyvaerts@gmail.com>

description:
  The Always-On Processor provides audio and sensor services through firmware
  loaded by the bootloader. The application processor patches the firmware's
  boot arguments in the AOP SRAM, starts it through RTKit over one mailbox and
  reaches its services through the RTKit endpoints. The bootloader reserves
  the firmware's external code and log segments as /reserved-memory nodes
  named aop-etext and aop-oslog; no mapping of them survives the reset of the
  AOP's DART, so the operating system maps them again before the start.

properties:
  compatible:
    const: apple,t6041-aop

  reg:
    minItems: 2
    items:
      - description: AOP SRAM, holding the boot-argument table
      - description: ASC wrapper and processor control registers
      - description: Second ASC register window
      - description: AOP configuration registers

  reg-names:
    minItems: 2
    items:
      - const: firmware
      - const: asc
      - const: asc-aux
      - const: config

  mboxes:
    maxItems: 1

  mbox-names:
    const: mbox

  iommus:
    maxItems: 1

  audio:
    type: object
    $ref: /schemas/sound/apple,t6041-aop-audio.yaml#
    description: The audio service.

  als:
    type: object
    description: The ambient light sensor service.
    additionalProperties: false

    properties:
      compatible:
        items:
          - const: apple,t6041-aop-als
          - const: apple,aop-als

    required:
      - compatible

  las:
    type: object
    description: The lid angle sensor service.
    additionalProperties: false

    properties:
      compatible:
        items:
          - const: apple,t6041-aop-las
          - const: apple,aop-las

    required:
      - compatible

required:
  - compatible
  - reg
  - mboxes
  - mbox-names
  - iommus

additionalProperties: false

examples:
  - |
    soc {
        #address-cells = <2>;
        #size-cells = <2>;

        aop@510c10000 {
            compatible = "apple,t6041-aop";
            reg = <0x5 0x10c10000 0x0 0x2e0000>,
                  <0x5 0x10600000 0x0 0x88000>,
                  <0x5 0x10050000 0x0 0x4000>,
                  <0x5 0x08328000 0x0 0x24>;
            reg-names = "firmware", "asc", "asc-aux", "config";
            mboxes = <&aop_mbox>;
            mbox-names = "mbox";
            iommus = <&aop_dart 0>;

            als {
                compatible = "apple,t6041-aop-als", "apple,aop-als";
            };

            las {
                compatible = "apple,t6041-aop-las", "apple,aop-las";
            };
        };
    };
```

## Documentation/devicetree/bindings/sound/apple,t6041-aop-audio.yaml
```yaml
# SPDX-License-Identifier: (GPL-2.0-only OR BSD-2-Clause)
%YAML 1.2
---
$id: http://devicetree.org/schemas/sound/apple,t6041-aop-audio.yaml#
$schema: http://devicetree.org/meta-schemas/core.yaml#

title: Apple T6041 AOP audio

maintainers:
  - Jonathan Goyvaerts <jonathan.goyvaerts@gmail.com>

description: |
  The Always-On Processor on Apple T6041 SoCs runs the machine's audio
  streams in its firmware: the microphone array, the internal speakers with
  their voltage and current sense, and the 3.5 mm headset jack in both
  directions. This node is a child of the AOP node and names the ADMAC
  channels the host moves each stream's data over while the firmware runs
  its serializer. The parent AOP binding describes the firmware transport.

  The headset jack's channels are optional: a node without them has no jack
  streams.

allOf:
  - $ref: dai-common.yaml#

properties:
  compatible:
    items:
      - const: apple,t6041-aop-audio
      - const: apple,t6030-aop-audio

  dmas:
    minItems: 3
    items:
      - description: Microphone array input
      - description: Internal speaker output
      - description: Speaker voltage and current sense input
      - description: Headset jack output
      - description: Headset microphone input

  dma-names:
    minItems: 3
    items:
      - const: dma
      - const: spkr
      - const: sense
      - const: cout
      - const: cin

  "#sound-dai-cells":
    const: 1
    description: |
      AOP audio DAI identifier:
        0, 1, 2 - the speaker card's front-ends: unused, the speakers and
                  their sense
        3 - the internal speaker back-end
        4 - the headset jack back-end

  apple,chassis-name:
    $ref: /schemas/types.yaml#/definitions/string
    description:
      Chassis identifier used to name the microphone sound card.

  apple,machine-kind:
    $ref: /schemas/types.yaml#/definitions/string
    description:
      Human-readable machine name used in the microphone sound card's
      description.

required:
  - compatible
  - dmas
  - dma-names
  - "#sound-dai-cells"
  - apple,chassis-name
  - apple,machine-kind

unevaluatedProperties: false

examples:
  - |
    aop {
        audio {
            compatible = "apple,t6041-aop-audio", "apple,t6030-aop-audio";
            apple,chassis-name = "J616";
            apple,machine-kind = "MacBook Pro";
            dmas = <&admac0 1>, <&admac1 0>, <&admac1 1>,
                   <&admac1 4>, <&admac1 5>;
            dma-names = "dma", "spkr", "sense", "cout", "cin";
            #sound-dai-cells = <1>;
        };
    };
```
